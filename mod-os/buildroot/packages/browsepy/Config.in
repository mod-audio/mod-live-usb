## mod-os/buildroot/packages/browsepy/Config.in
```kconfig
config BR2_PACKAGE_BROWSEPY
        bool "browsepy"
        select BR2_PACKAGE_PYTHON_FLASK
        select BR2_PACKAGE_PYTHON_SCANDIR
```

## mod-os/buildroot/packages/jack-capture/Config.in
```kconfig
config BR2_PACKAGE_JACK_CAPTURE
	bool "jack-capture"
	select BR2_PACKAGE_LIBSNDFILE
	select BR2_PACKAGE_JACK2MOD
```

## mod-os/buildroot/packages/mod-midi-merger/Config.in
```kconfig
config BR2_PACKAGE_MOD_MIDI_MERGER
	bool "mod-midi-merger"
	select BR2_PACKAGE_JACK2MOD
```

## mod-os/buildroot/packages/mod-peakmeter/Config.in
```kconfig
config BR2_PACKAGE_MOD_PEAKMETER
	bool "mod-peakmeter"
	select BR2_PACKAGE_JACK2MOD
```

## mod-os/buildroot/packages/mod-ui/Config.in
```kconfig
config BR2_PACKAGE_MOD_UI
	bool "mod-ui"
	select BR2_PACKAGE_PYTHON3
	select BR2_PACKAGE_JACK_CAPTURE
	select BR2_PACKAGE_MOD_HOST
	select BR2_PACKAGE_SNDFILE_TOOLS
	select BR2_PACKAGE_PYTHON_AGGDRAW
	select BR2_PACKAGE_PYTHON_PILLOW
	select BR2_PACKAGE_PYTHON_PYCRYPTO
	select BR2_PACKAGE_PYTHON_PYSTACHE
	select BR2_PACKAGE_PYTHON_SERIAL
	select BR2_PACKAGE_PYTHON_TORNADO
	select BR2_PACKAGE_PYTHON_SETUPTOOLS
```

## mod-os/buildroot/packages/sndfile-tools/Config.in
```kconfig
config BR2_PACKAGE_SNDFILE_TOOLS
	bool "sndfile-tools"
	select BR2_PACKAGE_CAIRO
	select BR2_PACKAGE_CAIRO_PNG
	select BR2_PACKAGE_FFTW_DOUBLE
	select BR2_PACKAGE_JACK2MOD
	select BR2_PACKAGE_LIBGLIB2
	select BR2_PACKAGE_LIBSAMPLERATE
	select BR2_PACKAGE_LIBSNDFILE
```
